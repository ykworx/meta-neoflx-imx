## conf/machine/neoflx.conf
```bitbake
#@TYPE: Machine
#@NAME: MDS Technology neoflxboard
#@SOC: i.MX6 Q/DL
#@DESCRIPTION: Machine configuration for MDS Technology Neo-FLX10 Board machines
#@MAINTAINER: yoonki kim <yoonki@mdstec.com>

# Machine config for the MDS Technology Neo-FLX10 Board machines.
# They all use the same machine config, since the u-boot SPL autodetects the
# machine type upon booting. SOC_FAMILY includes all SoCs from all of these machines
# to let recipes include firmware etc. for all of these SoCs.

require conf/machine/include/imx-base.inc
require conf/machine/include/tune-cortexa9.inc

SOC_FAMILY = "mx6:mx6dl:mx6q"

#PREFERRED_PROVIDER_virtual/bootloader = "u-boot-neoflx"
PREFERRED_PROVIDER_virtual/kernel = "linux-neoflx"
#PREFERRED_PROVIDER_virtual/kernel = "linux-fslc-imx-neoflx"

UBOOT_MAKE_TARGET = ""
UBOOT_SUFFIX = "img"
UBOOT_CONFIG ??= "sd"
UBOOT_CONFIG[sd] = "mx6neoflx_defconfig,sdcard"
UENV_FILENAME = "uEnv-${MACHINE}.txt"
SPL_BINARY = "SPL"

BOOT_SCRIPTS = "${UENV_FILENAME}:uEnv.txt"

KERNEL_IMAGETYPE = "zImage"
KERNEL_DEVICETREE = "imx6q-neoflx10.dtb imx6q-neoflx10-som-v15.dtb"

MACHINE_FEATURES += "wifi bluetooth alsa serial usbhost"
MACHINE_EXTRA_RRECOMMENDS += "bcm4330-nvram-config bcm4329-nvram-config"

SERIAL_CONSOLE = "115200 ttymxc0"
```
